## drivers/misc/sc1777y/Kconfig
```kconfig
# SPDX-License-Identifier: Apache-2.0

config SC1777Y
	bool "SC1777Y security chip"
	default y if DT_HAS_SENSCOMM_SC1777Y_ENABLED
	depends on SPI
	help
	  Enable the SC1777Y security chip driver skeleton.

config SC1777Y_EMUL
	bool "SC1777Y emulator"
	default y if DT_HAS_SENSCOMM_SC1777Y_ENABLED
	depends on EMUL && SPI_EMUL && SC1777Y
	help
	  Enable the SC1777Y SPI emulator skeleton.
```

## dts/bindings/misc/sc1777y-spi.yaml
```yaml
# SPDX-License-Identifier: Apache-2.0

description: SC1777Y security chip on SPI

compatible: "senscomm,sc1777y"

include:
  - spi-device.yaml
  - sc1777y.yaml
```

## dts/bindings/misc/sc1777y.yaml
```yaml
# SPDX-License-Identifier: Apache-2.0

description: SC1777Y security chip

properties:
  reset-gpios:
    type: phandle-array
    description: Optional reset or power-control GPIO for board integrations.
```

## subsys/net/lib/sc1777y_secure_channel/Kconfig
```kconfig
# SPDX-FileCopyrightText: Copyright The Zephyr Project Contributors
# SPDX-License-Identifier: Apache-2.0

# SC1777Y secure channel library configuration options

config SC1777Y_SECURE_CHANNEL
	bool "SC1777Y secure channel"
	depends on SC1777Y
	depends on NETWORKING
	depends on NET_SOCKETS
	select NET_CONTEXT_RCVTIMEO
	select NET_CONTEXT_SNDTIMEO
	help
	  Enable the SC1777Y-backed secure channel library.

config SC1777Y_SECURE_CHANNEL_MQTT
	bool "SC1777Y secure channel MQTT custom transport"
	depends on SC1777Y_SECURE_CHANNEL
	depends on MQTT_LIB
	depends on MQTT_LIB_CUSTOM_TRANSPORT
	help
	  Enable the thin MQTT custom transport adapter for the SC1777Y-backed
	  secure channel library.
```

## tests/net/lib/sc1777y_secure_channel/e2e/testcase.yaml
```yaml
# SPDX-FileCopyrightText: Copyright The Zephyr Project Contributors
# SPDX-License-Identifier: Apache-2.0

tests:
  net.lib.sc1777y_secure_channel.e2e:
    harness: pytest
    harness_config:
      pytest_root:
        - pytest
      pytest_dut_scope: function
    integration_platforms:
      - native_sim
    platform_allow:
      - native_sim
    tags:
      - net
      - pytest
      - sc1777y
    timeout: 60
```

## tests/net/lib/sc1777y_secure_channel/unit/testcase.yaml
```yaml
# SPDX-FileCopyrightText: Copyright The Zephyr Project Contributors
# SPDX-License-Identifier: Apache-2.0

tests:
  net.lib.sc1777y_secure_channel.unit:
    integration_platforms:
      - native_sim
    platform_allow:
      - native_sim
    tags:
      - net
      - sc1777y
```

## tests/net/lib/sc1777y_secure_mqtt_transport/e2e/testcase.yaml
```yaml
# SPDX-FileCopyrightText: Copyright The Zephyr Project Contributors
# SPDX-License-Identifier: Apache-2.0

tests:
  net.lib.sc1777y_secure_mqtt_transport.e2e:
    harness: pytest
    harness_config:
      pytest_root:
        - pytest
      pytest_dut_scope: function
    integration_platforms:
      - native_sim
    platform_allow:
      - native_sim
    tags:
      - net
      - mqtt
      - pytest
      - sc1777y
    timeout: 60
```

## tests/net/lib/sc1777y_secure_mqtt_transport/unit/testcase.yaml
```yaml
# SPDX-FileCopyrightText: Copyright The Zephyr Project Contributors
# SPDX-License-Identifier: Apache-2.0

tests:
  net.lib.sc1777y_secure_mqtt_transport.unit:
    integration_platforms:
      - native_sim
    platform_allow:
      - native_sim
    tags:
      - net
      - mqtt
      - sc1777y
```
